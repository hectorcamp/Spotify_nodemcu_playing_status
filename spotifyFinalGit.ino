//bibliotecas usadas
#if defined(ESP8266)
#include <ESP8266WiFi.h>
#elif defined(ESP32)
#include <WiFi.h>
#endif
#include <stdlib.h>
#include <WiFiClientSecure.h>
#include <SpotifyArduino.h>
#include <SpotifyArduinoCert.h>
#include <ArduinoJson.h>
#include <Wire.h>
#include <SSD1306.h>
#include "Roboto_Condensed_13.h"

//variaveis
//variaveis wifi
char ssid[] = "Nome_da_sua_rede_aqui";         // your network SSID (name)
char password[] = "Sua_senha_aqui"; // your network password

//variaveis para conectar ao spotify usando a api e a bilbioteca SpotifyArduino.h
char clientId[] = "******************************";     // Your client ID of your spotify APP
char clientSecret[] = "*************************"; // Your client Secret of your spotify APP (Do Not share this!)

#define SPOTIFY_MARKET "BR"  // código do país
//token do spotify
#define SPOTIFY_REFRESH_TOKEN "************************"

WiFiClientSecure client;
SpotifyArduino spotify(client, clientId, clientSecret, SPOTIFY_REFRESH_TOKEN);

unsigned long delayBetweenRequests = 1000; // Time between requests (1 minute)
unsigned long requestDueTime;               //time when request due
uint16_t nothingPlayingCount = 0;
uint16_t failedCount = 0;
boolean isPlaying = false;
String myArtist, mySong, myOldSong, myAlbum;
SSD1306 display(0x3c, D2, D1);
static const unsigned char PROGMEN pirate[] = {
  0x00, 0x00, 0x00, 0x00, 0x00, 0x00, 0x00, 0x00, 0x00, 0x00, 0x00, 0x00, 0x00, 0x00, 0x00, 0x00, 
    0x00, 0x00, 0x00, 0x00, 0x00, 0x00, 0x00, 0x00, 0x00, 0x00, 0x00, 0x00, 0x00, 0x00, 0x00, 0x00, 
    0x00, 0x00, 0x00, 0x00, 0x00, 0x00, 0x00, 0x00, 0x00, 0x00, 0x00, 0x00, 0x00, 0x00, 0x00, 0x00, 
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    0x00, 0x00, 0x00, 0x00, 0x00, 0x00, 0x00, 0x00, 0x00, 0x00, 0x00, 0x00, 0x00, 0x00, 0x00, 0x00
  };



void setup() {
  Serial.begin(115200);
  
  
  display.init();
  display.flipScreenVertically();
  display.setFont(Roboto_Condensed_13);
  display.drawBitmap(0, 0, pirate, 128, 64, 1); 
  display.display();

  WiFi.mode(WIFI_STA);
  WiFi.disconnect();
  delay(100);

  Serial.print("Connecting Wifi: ");
  Serial.println(ssid);
  WiFi.begin(ssid, password);
  while (WiFi.status() != WL_CONNECTED)
  {
    Serial.print(".");
    delay(500);
  }

  Serial.println("");
  Serial.println("WiFi connected");
  Serial.println("IP address: ");
  IPAddress ip = WiFi.localIP();
  Serial.println(ip);

  client.setFingerprint(SPOTIFY_FINGERPRINT);

  Serial.println("Refreshing Access Tokens");
  if (!spotify.refreshAccessToken()) {
  Serial.println("Failed to get access tokens");
  }  
}

void printCurrentlyPlayingToSerial(CurrentlyPlaying currentlyPlaying){

  Serial.println("--------- Currently Playing ---------");
  
  Serial.print("Is Playing: ");
    if (currentlyPlaying.isPlaying)
    {
        Serial.println("Yes");
    }else
    {
        Serial.println("No");
    }

  //busca faixa
  Serial.print("Track: ");
  Serial.println(currentlyPlaying.trackName);
  mySong = currentlyPlaying.trackName;

  //busca artista
  Serial.println("Artists: ");
    for (int i = 0; i < currentlyPlaying.numArtists; i++)
    {
        Serial.print("Name: ");
        Serial.println(currentlyPlaying.artists[i].artistName);
    }
    myArtist = currentlyPlaying.artists[0].artistName;   

    //busca album
    Serial.print("Album: ");
    Serial.println(currentlyPlaying.albumName);
    myAlbum = currentlyPlaying.albumName;

    long progress = currentlyPlaying.progressMs; // duration passed in the song
    long duration = currentlyPlaying.durationMs; // Length of Song
    Serial.print("Elapsed time of song (ms): ");
    Serial.print(progress);
    Serial.print(" of ");
    Serial.println(duration);
    Serial.println();

    float percentage = ((float)progress / (float)duration) * 100;
    int clampedPercentage = (int)percentage;
    Serial.print("<");
    for (int j = 0; j < 50; j++)
    {
        if (clampedPercentage >= (j * 2))
        {
            Serial.print("=");
        }
        else
        {
            Serial.print("-");
        }
    }
    Serial.println(">");
    Serial.println();   

 // }

//void displayCurrentlyPlaying(CurrentlyPlaying currentlyPlaying){
  
  if (currentlyPlaying.isPlaying){
    display.clear();
    display.setTextAlignment(TEXT_ALIGN_LEFT);
    display.drawString(0, 0, currentlyPlaying.trackName);
    display.drawString(0, 16, myArtist);
    display.drawString(0, 32, currentlyPlaying.albumName);

    float percentage = ((float)currentlyPlaying.progressMs / (float)currentlyPlaying.durationMs) * 100;
    isPlaying = currentlyPlaying.isPlaying;
    display.drawProgressBar(1, 50, 126, 10, (int)percentage);
    display.display();
    
    }
  
  
  
  }

void loop(){
   if (millis() > requestDueTime)
    {
        Serial.print("Free Heap: ");
        Serial.println(ESP.getFreeHeap());

        Serial.println("getting currently playing song:");
        // Market can be excluded if you want e.g. spotify.getCurrentlyPlaying()
        int status = spotify.getCurrentlyPlaying(printCurrentlyPlayingToSerial, SPOTIFY_MARKET);
        if (status == 200)
        {
            Serial.println("Successfully got currently playing");
        }
        else if (status == 204)
        {
        
            Serial.println("Doesn't seem to be anything playing");
        }
        else
        {
            Serial.print("Error: ");
            Serial.println(status);
        }
        requestDueTime = millis() + delayBetweenRequests;
    }
  
  
  
  }
